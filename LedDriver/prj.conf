## CMakeLists.txt
```
# SPDX-License-Identifier: Apache-2.0

cmake_minimum_required(VERSION 3.20.0)
find_package(Zephyr REQUIRED HINTS $ENV{ZEPHYR_BASE})
project(LedDriver)

target_sources(app PRIVATE src/main.c)
target_sources(app PRIVATE src/gpio.c)
target_sources(app PRIVATE src/leds.c)
target_sources(app PRIVATE src/adc.c)
target_sources(app PRIVATE src/filter.c)
target_sources(app PRIVATE src/pwm.c)
```

## prj.conf
```kconfig
CONFIG_PRINTK=y
CONFIG_HEAP_MEM_POOL_SIZE=1024
CONFIG_ASSERT=y
CONFIG_GPIO=y
CONFIG_TIMING_FUNCTIONS=y
CONFIG_USE_SEGGER_RTT=y
CONFIG_RTT_CONSOLE=n
CONFIG_ADC=y
CONFIG_UART_CONSOLE=y
CONFIG_PWM=y
```

## src/main.c
```c
#include "base.h"
#include "gpio.h"
#include "adc.h"
#include "filter.h"
#include "pwm.h"

/*

void main()
{
	printk("\n\n\n\n\n\n");
	filter_init();

	printk("%u \n",filter(0));
	printk("%u \n",filter(0));
	printk("%u \n",filter(0));
	printk("%u \n",filter(0));
	printk("%u \n",filter(0));
	printk("%u \n",filter(0));
	printk("%u \n",filter(0));
	printk("%u \n",filter(0));
	printk("%u \n",filter(0));
	printk("%u \n",filter(0));
	printk("%u \n",filter(120));
	printk("%u \n",filter(240));
	printk("%u \n",filter(120));
	printk("%u \n",filter(120));
	printk("%u \n",filter(120));
	printk("%u \n",filter(120));
	printk("%u \n",filter(120));
	printk("%u \n",filter(240));
	
}

*/

#define TOTAL_SAMPLES 144		///< total samples until the end of program
#define SAMPLING_PERIOD 1000		///< sampling period in miliseconds

#define SAMPLING_PRIO 1			///< sampling thread priority
#define FILTERING_PRIO 1		///< filtering thread priority
#define ACTUATING_PRIO 1		///< actuating thread priority

#define SAMPLING_STACK_SIZE 1024						///< sampling thread stack size
K_THREAD_STACK_DEFINE(sampling_stack,SAMPLING_STACK_SIZE);		///< sampling thread stack size
#define FILTERING_STACK_SIZE 512						///< filtering thread stack size
K_THREAD_STACK_DEFINE(filtering_stack,FILTERING_STACK_SIZE);	///< filtering thread stack size
#define ACTUATING_STACK_SIZE 512						///< actuating thread stack size
K_THREAD_STACK_DEFINE(actuating_stack,ACTUATING_STACK_SIZE);	///< actuating thread stack size

struct k_thread sampling_data;	///< sampling thread initialisation
k_tid_t sampling_tid;			///< sampling thread initialisation
struct k_thread filtering_data;	///< filtering thread initialisation
k_tid_t filtering_tid;			///< filtering thread initialisation
struct k_thread actuating_data;	///< actuating thread initialisation
k_tid_t actuating_tid;			///< actuating thread initialisation

const int64_t sampling_period=30000;	///< sampling thread period
struct k_sem sem_sample;			///< sample ready semafore
struct k_sem sem_filtsample;			///< filtered sample ready semafore

uint16_t filt_in;
uint16_t filt_out;

void sampling(void* A,void* B,void* C)
{
	printk("Launched sampling thread\n");
	int64_t curr_time=k_uptime_get();
	int64_t end_time=k_uptime_get()+sampling_period;
	while(1)
	{
		filt_in=adc_sample();
		printk("sampling: sampled ADC for %u\n",filt_in);
		k_sem_give(&sem_sample);
		printk("sampling: supplied a sample to filtering\n");

		curr_time=k_uptime_get();			// sleep until next sampling period
		if(curr_time<end_time)				// sleep until next sampling period
		{							// sleep until next sampling period
			k_msleep(end_time-curr_time);		// sleep until next sampling period
		}							// sleep until next sampling period
		end_time+=sampling_period;			// sleep until next sampling period
	}
}

void filtering(void* A,void* B,void* C)
{
	printk("Launched filtering thread\n");
	while(1)
	{
		printk("filtering: waiting for a sample from sampling\n");
		k_sem_take(&sem_sample,K_FOREVER);
		printk("filtering: got a sample from sampling\n");
		filt_out=filter(filt_in);
		printk("filtering: filtered %u sample to %u\n",filt_in,filt_out);
		k_sem_give(&sem_filtsample);
		printk("filtering: supplied a filtered sample to actuating\n");
	}
}

void actuating(void* A,void* B,void* C)
{
	printk("Launched actuating thread\n");
	while(1)
	{
		printk("actuating: waiting for a filtered sample from filtering\n");
		k_sem_take(&sem_filtsample,K_FOREVER);
		printk("actuating: got a filtered sample from filtering\n");
		pwm_led_set(filt_out*100/1023);
		printk("actuating: led has been set to %u\n",filt_out);
	}
}

void main()
{
	printk("\n\n\nStart\n");

	adc_init();
	filter_init();
	pwm_init();

	k_sem_init(&sem_sample, 0, 1);
	k_sem_init(&sem_filtsample, 0, 1);

	sampling_tid=k_thread_create(&sampling_data,sampling_stack,K_THREAD_STACK_SIZEOF(sampling_stack),
		sampling,NULL,NULL,NULL,SAMPLING_PRIO,0,K_NO_WAIT);

	filtering_tid=k_thread_create(&filtering_data,filtering_stack,K_THREAD_STACK_SIZEOF(filtering_stack),
		filtering,NULL,NULL,NULL,FILTERING_PRIO,0,K_NO_WAIT);

	actuating_tid=k_thread_create(&actuating_data,actuating_stack,K_THREAD_STACK_SIZEOF(actuating_stack),
		actuating,NULL,NULL,NULL,ACTUATING_PRIO,0,K_NO_WAIT);
}
```

## src/adc.c
```c
#include "adc.h"

// Global Variables:
static struct device *adc_dev = NULL;
static uint16_t adc_sample_buffer;

void adc_init()
{
      int err=0;

      /* ADC setup: bind and initialize */
      adc_dev = device_get_binding(DT_LABEL(ADC_NID));
      if (!adc_dev) 
      {
	    printk("ADC device_get_binding() failed\n");
      } 

      err = adc_channel_setup(adc_dev, &adc_conf);
      if (err) 
      {
	    printk("adc_channel_setup() failed with error code %d\n", err);
      }
      
      /* It is recommended to calibrate the SAADC at least once before use, and whenever the ambient temperature has changed by more than 10 °C */
      NRF_SAADC->TASKS_CALIBRATEOFFSET = 1;

	printk("Intialised ADC module\n");
}

/* Takes one sample */
uint16_t adc_sample()
{
	const struct adc_sequence sequence = {
		.channels=BIT(ADC_CHANNEL_ID),
		.buffer=&adc_sample_buffer,
		.buffer_size=sizeof(adc_sample_buffer),
		.resolution=ADC_RESOLUTION,
	};

	int ret = adc_read(adc_dev, &sequence);
	if (ret) {
            printk("adc_read() failed with code %d\n", ret);
	}

	if(adc_sample_buffer>ADC_MAX_VALUE)
	{
		adc_sample_buffer=ADC_MAX_VALUE;
	}
	else if(adc_sample_buffer<ADC_MIN_VALUE)
	{
		adc_sample_buffer=ADC_MIN_VALUE;
	}
	
	return adc_sample_buffer; 
}
```

## src/adc.h
```c
/**
* \file adc.h
* \brief Analog-Digital Converter module
*
* This module contains functions to implement an AD converter
*
* \author Filipe Loureiro & Miguel Silva
* \date 25/05/22
* \version 2.5
* \bug No bugs detected
*/

#ifndef ADC_H
#define ADC_H

#include "base.h"

#define ADC_MIN_VALUE 0
#define ADC_MAX_VALUE 1023

#define ADC_NID DT_NODELABEL(adc) 
#define ADC_RESOLUTION 10
#define TIMER_INTERVAL_MSEC 1000

// Parameters for adc Struct Configuration
#define ADC_GAIN ADC_GAIN_1_4
#define ADC_REFERENCE ADC_REF_VDD_1_4
#define ADC_ACQUISITION_TIME ADC_ACQ_TIME(ADC_ACQ_TIME_MICROSECONDS, 40)
#define ADC_CHANNEL_ID 1
#define ADC_CHANNEL_INPUT NRF_SAADC_INPUT_AIN1 

// ADC channel struct Configuration:
static struct adc_channel_cfg adc_conf = {
	.gain = ADC_GAIN,
	.reference = ADC_REFERENCE,
	.acquisition_time = ADC_ACQUISITION_TIME,
	.channel_id = ADC_CHANNEL_ID,
	.input_positive = ADC_CHANNEL_INPUT
};

///////////////////////////////////////////////////////////////////////////////////////
//  Public Functions:

/**
* \brief ADC initialization function
*
* Initializes the ADC in order to use it 
*
* \bug No bugs detected
*/
void adc_init();


/**
* \brief ADC read function
*
* Read a sample from ADC previosly configurated and return it
*
* \return Return the read value from adc
* \bug No bugs detected
*/
uint16_t adc_sample();

#endif
```

## src/base.h
```c
/**
* \file base.h
* \brief Base file
*
* This file contain the basic includes and macros for general porpouse
*
* \author Filipe Loureiro & Miguel Silva
* \date 25/05/22
* \version 2.5
* \bug No bugs detected
*/

#ifndef _BASE_H
#define _BASE_H

#include <zephyr.h>
#include <device.h>
#include <devicetree.h>
#include <drivers/gpio.h>
#include <sys/printk.h>
#include <sys/__assert.h>
#include <string.h>
#include <timing/timing.h>
#include <stdio.h>
#include <stdint.h>
#include <drivers/adc.h>
#include <hal/nrf_saadc.h>
#include <drivers/pwm.h>

#endif
```

## src/demo_adc.c
```c
/*
 * Paulo Pedreiras, 2022/03
 * Simple ADC example - nRF52840DK_nRF52840 board
 * 
 * 
 * Periodically reads ADC input and prints the corresponding raw and voltage value in the console
 * 
 * Adapted from: 
 *            https://devzone.nordicsemi.com/f/nordic-q-a/80685/using-saadc-in-nrf-connect-sdk/334204#334204
 *            https://github.com/simon-iversen/sdk-nrf/blob/light_controller/samples/light_controller/src/main.c
 * 
 *
 *      HW info
 *          https://infocenter.nordicsemi.com/topic/struct_nrf52/struct/nrf52840.html
 *          Section: nRF52840 Product Specification -> Peripherals -> GPIO / GPIOTE and SAADC 
 *          Board specific HW info can be found in the nRF52840_DK_User_Guide_20201203. I/O pins available at pg 27
 *
 *      Peripheral libs
 *          https://developer.nordicsemi.com/nRF_Connect_SDK/doc/latest/zephyr/reference/peripherals/index.html
 *          ADC     
 *
 *      NOTE 1:     **** NEVER APPLY MORE THAN 3 V (VDD) or negative voltages to ANx ****
 *
 *      NOTE 2:     In this board analog inputs are AIN{1,2,4,5,6,7} (see nRF52840_DK_User_Guide_20201203, page 28)
 *                  Some of the examples found in the internet are set to AIN0 and so do not work. The PCB also has a label "A0", which refers to Arduino and induces in error. 
 *    
 *      NOTE 3:     must add "CONFIG_ADC=y" to prj.conf
 * 
 */

#include <zephyr.h>
#include <device.h>
#include <drivers/gpio.h>
#include <drivers/adc.h>
#include <string.h>


/*ADC definitions and includes*/
#include <hal/nrf_saadc.h>
#define ADC_NID DT_NODELABEL(adc) 
#define ADC_RESOLUTION 10
#define ADC_GAIN ADC_GAIN_1_4
#define ADC_REFERENCE ADC_REF_VDD_1_4
#define ADC_ACQUISITION_TIME ADC_ACQ_TIME(ADC_ACQ_TIME_MICROSECONDS, 40)
#define ADC_CHANNEL_ID 1  

/* This is the actual nRF ANx input to use. Note that a channel can be assigned to any ANx. In fact a channel can */
/*    be assigned to two ANx, when differential reading is set (one ANx for the positive signal and the other one for the negative signal) */  
/* Note also that the configuration of differnt channels is completely independent (gain, resolution, ref voltage, ...) */
#define ADC_CHANNEL_INPUT NRF_SAADC_INPUT_AIN1 

#define BUFFER_SIZE 1

/* Other defines */
#define TIMER_INTERVAL_MSEC 1000 /* Interval between ADC samples */

/* ADC channel configuration */
static const struct adc_channel_cfg my_channel_cfg = {
	.gain = ADC_GAIN,
	.reference = ADC_REFERENCE,
	.acquisition_time = ADC_ACQUISITION_TIME,
	.channel_id = ADC_CHANNEL_ID,
	.input_positive = ADC_CHANNEL_INPUT
};

/* Global vars */
struct k_timer my_timer;
const struct device *adc_dev = NULL;
static uint16_t adc_sample_buffer[BUFFER_SIZE];

/* Takes one sample */
static int adc_sample(void)
{
	int ret;
	const struct adc_sequence sequence = {
		.channels = BIT(ADC_CHANNEL_ID),
		.buffer = adc_sample_buffer,
		.buffer_size = sizeof(adc_sample_buffer),
		.resolution = ADC_RESOLUTION,
	};

	if (adc_dev == NULL) {
            printk("adc_sample(): error, must bind to adc first \n\r");
            return -1;
	}

	ret = adc_read(adc_dev, &sequence);
	if (ret) {
            printk("adc_read() failed with code %d\n", ret);
	}	

	return ret;
}


void main(void)
{
    int err=0;

    /* Welcome message */
    printk("\n\r Simple adc demo for  \n\r");
    printk(" Reads an analog input connected to AN%d and prints its raw and mV value \n\r", ADC_CHANNEL_ID);
    printk(" *** ASSURE THAT ANx IS BETWEEN [0...3V]\n\r");
         
    /* ADC setup: bind and initialize */
    adc_dev = device_get_binding(DT_LABEL(ADC_NID));
	if (!adc_dev) {
        printk("ADC device_get_binding() failed\n");
    } 
    err = adc_channel_setup(adc_dev, &my_channel_cfg);
    if (err) {
        printk("adc_channel_setup() failed with error code %d\n", err);
    }
    
    /* It is recommended to calibrate the SAADC at least once before use, and whenever the ambient temperature has changed by more than 10 °C */
    NRF_SAADC->TASKS_CALIBRATEOFFSET = 1;
    
    /* Main loop */
    while(true){
        /* Get one sample, checks for errors and prints the values */
        err=adc_sample();
        if(err) {
            printk("adc_sample() failed with error code %d\n\r",err);
        }
        else {
            if(adc_sample_buffer[0] > 1023) {
                printk("adc reading out of range\n\r");
            }
            else {
                /* ADC is set to use gain of 1/4 and reference VDD/4, so input range is 0...VDD (3 V), with 10 bit resolution */
                printk("adc reading: raw:%4u / %4u mV: \n\r",adc_sample_buffer[0],(uint16_t)(1000*adc_sample_buffer[0]*((float)3/1023)));
            }
        }

        /* Sleep a while ... */
        k_msleep(TIMER_INTERVAL_MSEC);
    }
}
```

## src/filter.c
```c
#include "filter.h"

static filter_buffer buffer;

//////////////////////////////////////////////////////////////////////////////////////////////////////////////////////////////////////
// Private Member Functions

void insert_sample(uint16_t sample)
{
	sample=sample%(MAX_SAMPLE_VALUE+1);
//	printk("entered %u sample\n",sample);
	if(buffer.count>1)
	{
		if(sample<read_avg()-FILTER_THRESHOLD||sample>read_avg()+FILTER_THRESHOLD)
		{
			printk("sample rejected\n");
			return;
		}
	}
	buffer.pointer=(buffer.pointer+1)%FILTER_BUFFER_SIZE;
	buffer.array[buffer.pointer]=sample;
//	printk("inserted sample in position %u \n",buffer.pointer);
	if(buffer.count<FILTER_BUFFER_SIZE)
	{
		buffer.count++;
	}
//	printk("buffer has %u samples\n",buffer.count);
}

void avg_samples()
{
	if(buffer.count==0)
	{
		buffer.samples_avg=buffer.array[buffer.pointer];
	}
	else if(buffer.count>0&&buffer.count<FILTER_BUFFER_SIZE)
	{
//		printk("avg resized from %u",buffer.samples_avg);
		buffer.samples_avg=buffer.samples_avg*(buffer.count-1)/buffer.count;
//		printk(" to %u \n",buffer.samples_avg);

//		printk("added %u to the avg %u ",buffer.array[buffer.pointer],buffer.samples_avg);
		buffer.samples_avg+=buffer.array[buffer.pointer]/buffer.count;
//		printk("becoming avg %u \n",buffer.samples_avg);
	}
	else if(buffer.count>=FILTER_BUFFER_SIZE)
	{
//		printk("removed %u contribution to %u",buffer.array[(buffer.pointer+1)%FILTER_BUFFER_SIZE],buffer.samples_avg);
		buffer.samples_avg-=buffer.array[(buffer.pointer+1)%FILTER_BUFFER_SIZE]/(FILTER_BUFFER_SIZE-1);
//		printk(" becoming %u \n",buffer.samples_avg);

//		printk("added %u to the avg %u ",buffer.array[buffer.pointer],buffer.samples_avg);
		buffer.samples_avg+=buffer.array[buffer.pointer]/(FILTER_BUFFER_SIZE-1);
//		printk("becoming avg %u \n",buffer.samples_avg);
	}
}

uint16_t read_avg()
{
	return buffer.samples_avg;
}

//////////////////////////////////////////////////////////////////////////////////////////////////////////////////////////////////////
// Public Member Functions

void filter_init()
{
	uint8_t k=0;
	while(k<FILTER_BUFFER_SIZE)
	{
		buffer.array[k]=0;
		k++;
	}
	buffer.pointer=FILTER_BUFFER_SIZE-1;
	buffer.count=0;
	buffer.samples_avg=0;
	printk("Initialised filter operation\n");
}

uint16_t filter(uint16_t in)
{
	insert_sample(in);
	avg_samples();
	return read_avg();
}
```

## src/filter.h
```c
/**
* \file filter.h
* \brief Smart Filter module
*
* This module contains functions to implement the smart filter required
*
* \author Filipe Loureiro & Miguel Silva
* \date 25/05/22
* \version 2.4
* \bug No bugs detected
*/

#include "adc.h"

#define MAX_SAMPLE_VALUE 1023		///< max sample value
#define FILTER_BUFFER_SIZE 11		///< number of samples in each average plus the excluded old sample
#define FILTER_THRESHOLD 600		///< range of values centered in the sample average allowed for a sample value

typedef struct filter_buffer
{
	uint16_t array[FILTER_BUFFER_SIZE];
	uint8_t pointer;
	uint8_t count;
	uint16_t samples_avg;
}filter_buffer;

//////////////////////////////////////////////////////////////////////////////////////////////////////////////////////////////////////
// Private Member Functions

void insert_sample(uint16_t sample);
void avg_samples();
uint16_t read_avg();

//////////////////////////////////////////////////////////////////////////////////////////////////////////////////////////////////////
// Public Member Functions

/**
* \brief Filter initialisation function
*
* Initialises the filter buffer necessary for its operation
*
* \bug No bugs detected
*/
void filter_init();

/**
* \brief Filter operation function
*
* Inserts a new sample in the filter buffer, calculates the average of the samples in the filter buffer except the oldest and returns the last average calculated
*
* \param [IN] sample to be inserted
* \return last average calculated
* \bug No bugs detected
*/
uint16_t filter(uint16_t in);
```

## src/gpio.c
```c
#include "gpio.h"


/*
  const struct device *gpio0_dev;
  gpio0_dev=gpio0_init();
*/

struct device *gpio0_init()
{
  #define GPIO0_NID DT_NODELABEL(gpio0)                       // Get the gpio0 identifier from the device tree
  #define GPIO0_LABEL DT_LABEL(GPIO0_NID)                     // Get the gpio0 label from the device tree

  struct device *gpio0_dev;                                    // Pointer to GPIO device structure

  gpio0_dev=device_get_binding(GPIO0_LABEL);                
  if(gpio0_dev==NULL)
  {
    printk("Failed to bind to GPIO0\n\r");        
    return;
  }
  else
  {
    printk("Bind to GPIO0 successfull \n\r");        
  }    

  return gpio0_dev;
}


/*
  const struct device *gpio1_dev;
  gpio1_dev=gpio1_init();
*/

struct device *gpio1_init()
{
  #define GPIO1_NID DT_NODELABEL(gpio1)                       // Get the gpio0 identifier from the device tree
  #define GPIO1_LABEL DT_LABEL(GPIO1_NID)                     // Get the gpio0 label from the device tree

  struct device *gpio1_dev;                                    // Pointer to GPIO device structure

  gpio1_dev=device_get_binding(GPIO1_LABEL);                
  if(gpio1_dev==NULL)
  {
    printk("Failed to bind to GPIO1\n\r");        
    return;
  }
  else
  {
    printk("Bind to GPIO1 successfull \n\r");        
  }    

  return gpio1_dev;
}
```
